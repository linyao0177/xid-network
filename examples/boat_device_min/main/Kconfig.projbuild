## examples/boat_device_min/main/Kconfig.projbuild
```kconfig
menu "BoAT device"

config BOAT_NETWORK
    string "Network name to look up nodes by when there is no node list"
    default ""
    help
        Empty: "boat-mqtt". Release builds use "xid-testnet" (tools/release/sdkconfig.testnet).

config BOAT_VERIFIERS
    string "Verify keys of the verifiers to trust for the node list (comma-separated hex)"
    default ""
    help
        Empty: the device looks up BOAT_NETWORK instead. Release builds trust the
        public testnet's verifiers (tools/release/sdkconfig.testnet).

config BOAT_READERS
    string "Ed25519 keys that may read sealed readings (comma-separated hex)"
    default ""
    help
        The owner's key, compute nodes' work keys. Empty: readings are signed, not sealed.

config BOAT_INTERVAL
    int "Seconds between readings"
    default 10

endmenu
```

## examples/depin_station/main/Kconfig.projbuild
```kconfig
menu "DePIN station"

config BOAT_NETWORK
    string "Network name to look up nodes by when there is no node list"
    default "xid-testnet"

config BOAT_VERIFIERS
    string "Verify keys of the verifiers to trust for the node list (comma-separated hex)"
    default ""
    help
        The public testnet's come from tools/release/sdkconfig.testnet.

config DEPIN_INTERVAL
    int "Seconds between readings"
    default 60
    help
        A slot counts as up when it has one reading; the testnet's weather
        network has 5-minute slots.

config DEPIN_WEATHER_DEMO
    bool "Weather readings from the chip: t from its temperature sensor, h and p made up"
    default y
    help
        For the testnet's weather network on a bare board. A real station
        reads its sensors in read_fields() (main.c) instead.

endmenu
```

## examples/mqtt_p2p/main/Kconfig.projbuild
```kconfig
menu "MQTT over HyperDHT"

config MQTT_P2P_NODE
    string "Network name, or a node's public key in hex"
    default "boat-mqtt"
    help
        A network name: the device looks up BLAKE2b-256(name) on HyperDHT and
        connects to one of the nodes announced there (packages/boat-mqtt-node).
        64 hex characters: that node only.

config MQTT_P2P_VERIFIERS
    string "Verify keys of the verifiers to trust for the node list"
    default ""
    help
        Comma-separated verify keys (hex) of verifier nodes
        (packages/boat-registry). When set, the device takes the staked
        nodes a quorum of them lists (2 of 3) and connects only to those,
        instead of looking up the network name; when a list names other
        verifiers, it trusts those from then on (kept in NVS). Empty: look up
        the network name.

config MQTT_P2P_INTERVAL
    int "Seconds between telemetry messages"
    default 5

config MQTT_P2P_SIGN
    bool "Sign telemetry with the device key"
    default y
    help
        Each telemetry message carries the device's Ed25519 signature over the
        topic, a sequence number and the payload (hdht_mqtt_sign), so apps can
        check it whatever node or bridge it came through.

config MQTT_P2P_METER
    bool "Simulate a meter with a relay (pay-to-power demo)"
    default n
    help
        Telemetry reports the energy delivered to a simulated load ("mwh"),
        which only counts while the relay is on. The owner switches the relay.

config MQTT_P2P_LOAD_W
    int "Simulated load, in watts"
    depends on MQTT_P2P_METER
    default 1200

config MQTT_P2P_OWNER
    string "The owner's public key (hex): the only one who may switch the relay"
    depends on MQTT_P2P_METER
    default ""

config MQTT_P2P_RELAY_GPIO
    int "GPIO that drives the relay (-1: none)"
    depends on MQTT_P2P_METER
    default -1

endmenu
```
